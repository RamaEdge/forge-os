## kernel/configs/aarch64_defconfig
```kconfig
# ForgeOS aarch64 Kernel Configuration
# Hardened configuration for edge computing

# Basic system
CONFIG_ARM64=y
CONFIG_64BIT=y
CONFIG_MMU=y
CONFIG_ARCH_MMAP_RND_BITS=18
CONFIG_ARCH_MMAP_RND_COMPAT_BITS=11

# Security hardening
CONFIG_RANDOMIZE_BASE=y
CONFIG_RANDOMIZE_MEMORY=y
CONFIG_STACKPROTECTOR_STRONG=y
CONFIG_SLUB_DEBUG=y
CONFIG_HARDENED_USERCOPY=y
CONFIG_FORTIFY_SOURCE=y

# Mandatory Access Control
CONFIG_SECURITY=y
CONFIG_SECURITY_APPARMOR=y
CONFIG_SECURITY_APPARMOR_BOOTPARAM_VALUE=1
CONFIG_SECURITY_APPARMOR_HASH=y
CONFIG_SECURITY_APPARMOR_HASH_DEFAULT=y

# System call filtering
CONFIG_SECCOMP=y
CONFIG_SECCOMP_FILTER=y

# Memory protection
CONFIG_STRICT_DEVMEM=y
CONFIG_IO_STRICT_DEVMEM=y
CONFIG_DEBUG_WX=y

# Initramfs support
CONFIG_BLK_DEV_INITRD=y
CONFIG_INITRAMFS_SOURCE=""

# Device tree and hardware
CONFIG_DEVTMPFS=y
CONFIG_DEVTMPFS_MOUNT=y

# VirtIO support for QEMU
CONFIG_VIRTIO=y
CONFIG_VIRTIO_PCI=y
CONFIG_VIRTIO_MMIO=y
CONFIG_VIRTIO_BLK=y
CONFIG_VIRTIO_NET=y
CONFIG_VIRTIO_CONSOLE=y

# Network stack
CONFIG_NET=y
CONFIG_INET=y
CONFIG_IP_MULTICAST=y
CONFIG_IP_ADVANCED_ROUTER=y
CONFIG_IP_MULTIPLE_TABLES=y
CONFIG_NETFILTER=y
CONFIG_NETFILTER_ADVANCED=y
CONFIG_NF_TABLES=y
CONFIG_NF_TABLES_INET=y
CONFIG_NF_TABLES_NETDEV=y

# File systems
CONFIG_EXT4_FS=y
CONFIG_EXT4_FS_POSIX_ACL=y
CONFIG_EXT4_FS_SECURITY=y
CONFIG_TMPFS=y
CONFIG_TMPFS_POSIX_ACL=y

# Console and serial
CONFIG_SERIAL_AMBA_PL011=y
CONFIG_SERIAL_AMBA_PL011_CONSOLE=y
CONFIG_SERIAL_CORE=y
CONFIG_SERIAL_CORE_CONSOLE=y

# Power management
CONFIG_CPU_FREQ=y
CONFIG_CPU_FREQ_DEFAULT_GOV_ONDEMAND=y
CONFIG_CPU_FREQ_GOV_ONDEMAND=y
CONFIG_CPU_FREQ_GOV_PERFORMANCE=y

# Compiler optimizations
CONFIG_CC_OPTIMIZE_FOR_SIZE=y
CONFIG_CC_OPTIMIZE_FOR_PERFORMANCE=y
```

## userland/busybox/configs/busybox_defconfig
```kconfig
# ForgeOS BusyBox Configuration
# Static build with essential applets for edge computing

# Build options
CONFIG_STATIC=y
CONFIG_PREFIX="_install"
CONFIG_FEATURE_BUFFERS_USE_MALLOC=y
CONFIG_FEATURE_BUFFERS_GO_ON_STACK=n
CONFIG_FEATURE_BUFFERS_GO_IN_BSS=n

# Core applets
CONFIG_INIT=y
CONFIG_SH=y
CONFIG_MDEV=y
CONFIG_UHCPC=y

# Network applets
CONFIG_IFCONFIG=y
CONFIG_IP=y
CONFIG_SYSLOGD=y
CONFIG_KLOGD=y

# System applets
CONFIG_PS=y
CONFIG_MOUNT=y
CONFIG_UMOUNT=y
CONFIG_CHMOD=y
CONFIG_CHOWN=y

# Utility applets
CONFIG_LS=y
CONFIG_CAT=y
CONFIG_ECHO=y
CONFIG_MKDIR=y
CONFIG_RMDIR=y

# Additional essential applets
CONFIG_ASH=y
CONFIG_ASH_OPTIMIZE_FOR_SIZE=y
CONFIG_ASH_ALIAS=y
CONFIG_ASH_GETOPTS=y
CONFIG_ASH_CMDCMD=y
CONFIG_ASH_MAIL=y
CONFIG_ASH_PRINTF=y
CONFIG_ASH_TEST=y
CONFIG_ASH_HELP=y
CONFIG_ASH_READ=y
CONFIG_ASH_LOOPS=y
CONFIG_ASH_ARITH=y
CONFIG_ASH_CROND=y
CONFIG_ASH_CRONTAB=y

# File system support
CONFIG_FEATURE_MOUNT_NFS=y
CONFIG_FEATURE_MOUNT_CIFS=y
CONFIG_FEATURE_MOUNT_FLAGS=y
CONFIG_FEATURE_MOUNT_FSTAB=y

# Network support
CONFIG_FEATURE_IFCONFIG_STATUS=y
CONFIG_FEATURE_IFCONFIG_SLIP=y
CONFIG_FEATURE_IFCONFIG_MEMSTART_IOADDR=y
CONFIG_FEATURE_IFCONFIG_HW=y
CONFIG_FEATURE_IFCONFIG_BROADCAST_PLUS=y

# Security features
CONFIG_FEATURE_SUID=y
CONFIG_FEATURE_SUID_CONFIG=y
CONFIG_FEATURE_SUID_CONFIG_QUIET=y

# Size optimization
CONFIG_FEATURE_USE_INITTAB=y
CONFIG_FEATURE_KILL_REMOVED=y
CONFIG_FEATURE_KILL_DELAY=0
CONFIG_FEATURE_INIT_SCTTY=y
CONFIG_FEATURE_INIT_SYSLOG=y
CONFIG_FEATURE_INIT_QUIET=y
CONFIG_FEATURE_INIT_COREDUMPS=y
CONFIG_FEATURE_INIT_MODIFY_CMDLINE=y
```
